AUTOSAR XML
5 x :
  ContainerX  # RR
  ContainerM  # MM
  ContainerL  # QQ
  ContainerS  # HH
  ContainerS  # SS
