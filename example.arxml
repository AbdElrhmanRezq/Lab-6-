AUTOSAR XML
5 x :
  ContainerC  # QQ
  ContainerD  # MM
  ContainerA  # HH
  ContainerB  # SS
  ContainerB  # RR
